## conf/layer.conf
```bitbake
# We have a conf and classes directory, add to BBPATH
BBPATH .= ":${LAYERDIR}"

# We have recipes-* directories, add to BBFILES
BBFILES += "${LAYERDIR}/recipes-*/*/*.bb \
         ${LAYERDIR}/recipes-*/*/*.bbappend \
         ${LAYERDIR}/recipes-*/*/*/*.bbappend"

BBFILE_COLLECTIONS += "bksv-open"
BBFILE_PATTERN_bksv-open = "^${LAYERDIR}/"
BBFILE_PRIORITY_bksv-open = "99"
LAYERVERSION_bksv-open = "3"
LAYERSERIES_COMPAT_bksv-open = "thud"
```
